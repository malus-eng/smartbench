/dts-v1/;
/plugin/;

/ {
    compatible = "radxa,rock-3c", "rockchip,rk3566";

    fragment@0 {
        target = <&uart3>;
        __overlay__ {
            status = "okay";
            pinctrl-names = "default";
            pinctrl-0 = <&uart3m0_xfer>;

            sts3215 {
                compatible = "malus,sts3215";
                current-speed = <1000000>;
            };
        };
    };
};
